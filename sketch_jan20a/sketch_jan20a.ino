#define PIN_SCE   7
#define PIN_RESET 6
#define PIN_DC    5
#define PIN_SDIN  4
#define PIN_SCLK  3

#define LCD_C     LOW
#define LCD_D     HIGH

#define LCD_X     84
#define LCD_Y     48

int photodiodePin = A0;
int tempPin = A1;
int humiditySensor = A2;
int motor = A5;
int sol = A4;
int motorPin = 11;
int pwm;

static const byte ASCII[][5] =
{
 {0x00, 0x00, 0x00, 0x00, 0x00} // 20  
,{0x00, 0x00, 0x5f, 0x00, 0x00} // 21 !
,{0x00, 0x07, 0x00, 0x07, 0x00} // 22 "
,{0x14, 0x7f, 0x14, 0x7f, 0x14} // 23 #
,{0x24, 0x2a, 0x7f, 0x2a, 0x12} // 24 $
,{0x23, 0x13, 0x08, 0x64, 0x62} // 25 %
,{0x36, 0x49, 0x55, 0x22, 0x50} // 26 &
,{0x00, 0x05, 0x03, 0x00, 0x00} // 27 '
,{0x00, 0x1c, 0x22, 0x41, 0x00} // 28 (
,{0x00, 0x41, 0x22, 0x1c, 0x00} // 29 )
,{0x14, 0x08, 0x3e, 0x08, 0x14} // 2a *
,{0x08, 0x08, 0x3e, 0x08, 0x08} // 2b +
,{0x00, 0x50, 0x30, 0x00, 0x00} // 2c ,
,{0x08, 0x08, 0x08, 0x08, 0x08} // 2d -
,{0x00, 0x60, 0x60, 0x00, 0x00} // 2e .
,{0x20, 0x10, 0x08, 0x04, 0x02} // 2f /
,{0x3e, 0x51, 0x49, 0x45, 0x3e} // 30 0
,{0x00, 0x42, 0x7f, 0x40, 0x00} // 31 1
,{0x42, 0x61, 0x51, 0x49, 0x46} // 32 2
,{0x21, 0x41, 0x45, 0x4b, 0x31} // 33 3
,{0x18, 0x14, 0x12, 0x7f, 0x10} // 34 4
,{0x27, 0x45, 0x45, 0x45, 0x39} // 35 5
,{0x3c, 0x4a, 0x49, 0x49, 0x30} // 36 6
,{0x01, 0x71, 0x09, 0x05, 0x03} // 37 7
,{0x36, 0x49, 0x49, 0x49, 0x36} // 38 8
,{0x06, 0x49, 0x49, 0x29, 0x1e} // 39 9
,{0x00, 0x36, 0x36, 0x00, 0x00} // 3a :
,{0x00, 0x56, 0x36, 0x00, 0x00} // 3b ;
,{0x08, 0x14, 0x22, 0x41, 0x00} // 3c <
,{0x14, 0x14, 0x14, 0x14, 0x14} // 3d =
,{0x00, 0x41, 0x22, 0x14, 0x08} // 3e >
,{0x02, 0x01, 0x51, 0x09, 0x06} // 3f ?
,{0x32, 0x49, 0x79, 0x41, 0x3e} // 40 @
,{0x7e, 0x11, 0x11, 0x11, 0x7e} // 41 A
,{0x7f, 0x49, 0x49, 0x49, 0x36} // 42 B
,{0x3e, 0x41, 0x41, 0x41, 0x22} // 43 C
,{0x7f, 0x41, 0x41, 0x22, 0x1c} // 44 D
,{0x7f, 0x49, 0x49, 0x49, 0x41} // 45 E
,{0x7f, 0x09, 0x09, 0x09, 0x01} // 46 F
,{0x3e, 0x41, 0x49, 0x49, 0x7a} // 47 G
,{0x7f, 0x08, 0x08, 0x08, 0x7f} // 48 H
,{0x00, 0x41, 0x7f, 0x41, 0x00} // 49 I
,{0x20, 0x40, 0x41, 0x3f, 0x01} // 4a J
,{0x7f, 0x08, 0x14, 0x22, 0x41} // 4b K
,{0x7f, 0x40, 0x40, 0x40, 0x40} // 4c L
,{0x7f, 0x02, 0x0c, 0x02, 0x7f} // 4d M
,{0x7f, 0x04, 0x08, 0x10, 0x7f} // 4e N
,{0x3e, 0x41, 0x41, 0x41, 0x3e} // 4f O
,{0x7f, 0x09, 0x09, 0x09, 0x06} // 50 P
,{0x3e, 0x41, 0x51, 0x21, 0x5e} // 51 Q
,{0x7f, 0x09, 0x19, 0x29, 0x46} // 52 R
,{0x46, 0x49, 0x49, 0x49, 0x31} // 53 S
,{0x01, 0x01, 0x7f, 0x01, 0x01} // 54 T
,{0x3f, 0x40, 0x40, 0x40, 0x3f} // 55 U
,{0x1f, 0x20, 0x40, 0x20, 0x1f} // 56 V
,{0x3f, 0x40, 0x38, 0x40, 0x3f} // 57 W
,{0x63, 0x14, 0x08, 0x14, 0x63} // 58 X
,{0x07, 0x08, 0x70, 0x08, 0x07} // 59 Y
,{0x61, 0x51, 0x49, 0x45, 0x43} // 5a Z
,{0x00, 0x7f, 0x41, 0x41, 0x00} // 5b [
,{0x02, 0x04, 0x08, 0x10, 0x20} // 5c ¥
,{0x00, 0x41, 0x41, 0x7f, 0x00} // 5d ]
,{0x04, 0x02, 0x01, 0x02, 0x04} // 5e ^
,{0x40, 0x40, 0x40, 0x40, 0x40} // 5f _
,{0x00, 0x01, 0x02, 0x04, 0x00} // 60 `
,{0x20, 0x54, 0x54, 0x54, 0x78} // 61 a
,{0x7f, 0x48, 0x44, 0x44, 0x38} // 62 b
,{0x38, 0x44, 0x44, 0x44, 0x20} // 63 c
,{0x38, 0x44, 0x44, 0x48, 0x7f} // 64 d
,{0x38, 0x54, 0x54, 0x54, 0x18} // 65 e
,{0x08, 0x7e, 0x09, 0x01, 0x02} // 66 f
,{0x0c, 0x52, 0x52, 0x52, 0x3e} // 67 g
,{0x7f, 0x08, 0x04, 0x04, 0x78} // 68 h
,{0x00, 0x44, 0x7d, 0x40, 0x00} // 69 i
,{0x20, 0x40, 0x44, 0x3d, 0x00} // 6a j 
,{0x7f, 0x10, 0x28, 0x44, 0x00} // 6b k
,{0x00, 0x41, 0x7f, 0x40, 0x00} // 6c l
,{0x7c, 0x04, 0x18, 0x04, 0x78} // 6d m
,{0x7c, 0x08, 0x04, 0x04, 0x78} // 6e n
,{0x38, 0x44, 0x44, 0x44, 0x38} // 6f o
,{0x7c, 0x14, 0x14, 0x14, 0x08} // 70 p
,{0x08, 0x14, 0x14, 0x18, 0x7c} // 71 q
,{0x7c, 0x08, 0x04, 0x04, 0x08} // 72 r
,{0x48, 0x54, 0x54, 0x54, 0x20} // 73 s
,{0x04, 0x3f, 0x44, 0x40, 0x20} // 74 t
,{0x3c, 0x40, 0x40, 0x20, 0x7c} // 75 u
,{0x1c, 0x20, 0x40, 0x20, 0x1c} // 76 v
,{0x3c, 0x40, 0x30, 0x40, 0x3c} // 77 w
,{0x44, 0x28, 0x10, 0x28, 0x44} // 78 x
,{0x0c, 0x50, 0x50, 0x50, 0x3c} // 79 y
,{0x44, 0x64, 0x54, 0x4c, 0x44} // 7a z
,{0x00, 0x08, 0x36, 0x41, 0x00} // 7b {
,{0x00, 0x00, 0x7f, 0x00, 0x00} // 7c |
,{0x00, 0x41, 0x36, 0x08, 0x00} // 7d }
,{0x10, 0x08, 0x08, 0x10, 0x08} // 7e ←
,{0x78, 0x46, 0x41, 0x46, 0x78} // 7f →
};

void LcdCharacter(char character)
{
  LcdWrite(LCD_D, 0x00);
  for (int index = 0; index < 5; index++)
  {
    LcdWrite(LCD_D, ASCII[character - 0x20][index]);
  }
  LcdWrite(LCD_D, 0x00);
}

void LcdClear(void)
{
  for (int index = 0; index < LCD_X * LCD_Y / 8; index++)
  {
    LcdWrite(LCD_D, 0x00);
  }
}

void LcdInitialise(void)
{
  pinMode(PIN_SCE, OUTPUT);
  pinMode(PIN_RESET, OUTPUT);
  pinMode(PIN_DC, OUTPUT);
  pinMode(PIN_SDIN, OUTPUT);
  pinMode(PIN_SCLK, OUTPUT);
  digitalWrite(PIN_RESET, LOW);
  digitalWrite(PIN_RESET, HIGH);
  LcdWrite(LCD_C, 0x21 );  // LCD Extended Commands.
  LcdWrite(LCD_C, 0xB1 );  // Set LCD Vop (Contrast). 
  LcdWrite(LCD_C, 0x04 );  // Set Temp coefficent. //0x04
  LcdWrite(LCD_C, 0x14 );  // LCD bias mode 1:48. //0x13
  LcdWrite(LCD_C, 0x20 );  // LCD Basic Commands
  LcdWrite(LCD_C, 0x0C );  // LCD in normal mode.
}

void LcdString(char *characters)
{
  while (*characters)
  {
    LcdCharacter(*characters++);
  }
}

void LcdWrite(byte dc, byte data)
{
  digitalWrite(PIN_DC, dc);
  digitalWrite(PIN_SCE, LOW);
  shiftOut(PIN_SDIN, PIN_SCLK, MSBFIRST, data);
  digitalWrite(PIN_SCE, HIGH);
}

void setup(void)
{
  Serial.begin(9600);
  Serial.println("\nVoltage(V):");
  Serial.print("--------------------------------------------------\n");
  LcdInitialise();
  LcdClear();
  LcdString("Hello!");

  pinMode(11, OUTPUT);
  Serial.begin(9600);
}

void loop(void)
{
  
  float anaValueTemp = analogRead(tempPin); // read temperature analog
  float volts = anaValueTemp*5/1023;
  
  float volt_temp = anaValueTemp*5/1023;
  //float volt_offset = volt_temp - 2.57;
  float kp = anaValueTemp - 80;
  float temperature = (kp*91)/1023;
  //float temperature = volt_temp*91/5;
  //float temperature = (100/4.97 * (volt_temp + 11.11))- 273.15;
  Serial.println(String(temperature)+" Temperature"); //Temperature

  float humidity_analog = analogRead(humiditySensor); //read humidity analog
  float humidity = (2*0.000001*pow(humidity_analog, 3))-(0.0003*pow(humidity_analog,2))+(0.1596*humidity_analog)-(0.27779*temperature)+32.636;
  Serial.println(String(humidity)+"  Air Humidity"); //Air humidity
  
  float lx = analogRead(photodiodePin); // Lx
  if (lx <= 1 && lx >= 0)
  {
    Serial.println(String(lx)+" lx - Tres sobmre");
  }
  if (lx <= 1023 && lx >= 330)
  {
    Serial.println(String(lx)+" Lx - Tres lumineux");
  }
  if (lx <=329 && lx >= 9)
  {
    Serial.println(String(lx)+" Lx - Lumineux");
  }
  if (lx <= 8 && lx >= 4)
  {
    Serial.println(String(lx)+" Lx - Intermiediaire");
  }
  if (lx <= 3 && lx >= 2)
  {
    Serial.println(String(lx)+" Lx - Sombre");
  }

  float humidity_sol = analogRead(sol); //Sol humidity
  Serial.println(String(humidity_sol)+" Sol Humidity");

  //Algorythm
  if (humidity_sol < 250)
  {
    pwm =255;
    digitalWrite(11,pwm);
    LcdInitialise();
    LcdClear();
    LcdString("SEC");
    Serial.println("SEC");
     float motor = analogRead(motorPin);
  Serial.println(String(motor)+" Motor");
  }
  if (humidity_sol > 600)
  {
    pwm =0;
    digitalWrite(11,pwm);
    LcdInitialise();
    LcdClear();
    LcdString("TRES HUMIDE");
    Serial.println("TRES HUMIDE");
     float motor = analogRead(motorPin);
  Serial.println(String(motor)+" Motor");
  }
  if (humidity_sol < 600 && humidity_sol > 250)
  {
     if (temperature > 25)
     {
      if (humidity > 60)
      {
        pwm =0;
        digitalWrite(11,pwm);
        LcdInitialise();
        LcdClear();
        LcdString("HUMIDE SOL & AIR | T>25 ºC");
        Serial.println("HUMIDE SOL & AIR | T>25 ºC");
         float motor = analogRead(motorPin);
  Serial.println(String(motor)+" Motor");
      }
      else
      {
         pwm =20;
         digitalWrite(11,pwm);
         LcdInitialise();
         LcdClear();
         LcdString("HUMIDE | T>25 ºC");
         Serial.println("HUMIDE | T>25 ºC");
          float motor = analogRead(motorPin);
  Serial.println(String(motor)+" Motor");
      }
     }
     else 
     {
        pwm =0;
        digitalWrite(11,pwm);
        LcdInitialise();
        LcdClear();
        LcdString("HUMIDE | T<25 ºC");
        Serial.println("HUMIDE | T<25 ºC");
         float motor = analogRead(motorPin);
  Serial.println(String(motor)+" Motor");
     }
  }
  if (lx >= 330)
  {
        LcdInitialise();
        LcdClear();
        LcdString("ATTENTION: Luminosite tres elevee");
  }



  /*
  if(humidity_sol>600)
  {
    //TRES humide
    pwm =0;
    digitalWrite(11,pwm);
    Serial.println("TRES HUMIDE");
  }
  else
  {
    if (humidity_sol < 250)
    {
      //SEC
      pwm = 255;
      digitalWrite(11, pwm);
      Serial.println("SEC");
      //delay(2000);
    }
    else 
    {
      //Humide
      if (temperature > 30 && humidity<40)
      {
        pwm = 127;
        digitalWrite(11, pwm);
        Serial.println("PEU HUMIDE + CHAUD");
        //delay(600);
      }
      else
      {
        if (temperature < 30 && temperature >25)
        {
          pwm = 127;
          digitalWrite(11, pwm);
        //delay(600);
          Serial.println("HUMIDE + UN PEU CHAUD");
        }
        digitalWrite(11, 0);
      }
    }
  }*/
  Serial.println("----------------");
  delay(3000); //delay to prevent any duplicates
}
